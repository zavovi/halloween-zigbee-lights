## main/Kconfig.projbuild
```kconfig
menu "Halloween Configuration"		
    config HALLOWEEN_LED_LEVEL_HIGH
        bool "LED Level High"
        default y
		
    config HALLOWEEN_BRIGHTNESS_ENABLE
        bool "Enable Brightness"
        default y
		
    config HALLOWEEN_BRIGHTNESS_FREQ
        int "Brightness PWM Frequency"
		depends on HALLOWEEN_BRIGHTNESS_ENABLE
        default 1000
		
    config HALLOWEEN_BLINK_ENABLE
        bool "Enable blink effect"
        default n
		
    config HALLOWEEN_AUDIO_ENABLE
        bool "Enable audio (BZZ) effect"
        default n
		
    config HALLOWEEN_ENABLE_SLEEP
        bool "Enable sleep"
        default y
		
    config HALLOWEEN_BATTERY_DEVICE
        bool "Device is battery powered"
        default y
    
endmenu
```
